## src/esp32/Kconfig
```kconfig
# Kconfig settings for Espressif ESP32 series processors

if MACH_ESP32

config ESP32_SELECT
    bool
    default y
    select HAVE_GPIO
    select HAVE_GPIO_ADC
    select HAVE_GPIO_I2C
    select HAVE_GPIO_SPI
    select HAVE_GPIO_BITBANGING
    select HAVE_STRICT_TIMING
    select HAVE_CHIPID
    select HAVE_GPIO_HARD_PWM
    select HAVE_STEPPER_BOTH_EDGE

config BOARD_DIRECTORY
    string
    default "esp32"

choice
    prompt "Processor model"
    config MACH_ESP32_32
        bool "ESP32"
    config MACH_ESP32_S2
        bool "ESP32-S2"
    config MACH_ESP32_S3
        bool "ESP32-S3"
    config MACH_ESP32_C2
        bool "ESP32-C2"
    config MACH_ESP32_C3
        bool "ESP32-C3"
endchoice

config MCU
    string
    default "esp32" if MACH_ESP32_32
    default "esp32s2" if MACH_ESP32_S2
    default "esp32s3" if MACH_ESP32_S3
    default "esp32c2" if MACH_ESP32_C2
    default "esp32c3" if MACH_ESP32_C3

config CROSS_PREFIX
    string
    default "xtensa-esp32-elf-" if MACH_ESP32_32
    default "xtensa-esp32s2-elf-" if MACH_ESP32_S2
    default "xtensa-esp32s3-elf-" if MACH_ESP32_33
    default "riscv32-esp-elf-" if MACH_ESP32_C2
    default "riscv32-esp-elf-" if MACH_ESP32_C3

config CLOCK_FREQ
    int
    default 240000000 if MACH_ESP32_32
    default 240000000 if MACH_ESP32_S2
    default 240000000 if MACH_ESP32_S3
    default 120000000 if MACH_ESP32_C2
    default 160000000 if MACH_ESP32_C3

config FLASH_SIZE
    hex
    default 0x80000

config RAM_START
    hex
    default 0x10000000

config RAM_SIZE
    hex
    default 0x7fe0 # (0x8000 - 32) - top 32 bytes used by IAP functions

config STACK_SIZE
    int
    default 512

config SMOOTHIEWARE_BOOTLOADER
    bool "Target board uses Smoothieware bootloader"
    default y

config FLASH_START
    hex
    default 0x4000 if SMOOTHIEWARE_BOOTLOADER
    default 0x0000

config USBSERIAL
    bool
config SERIAL
    bool
choice
    prompt "Communication interface"
    config ESP32_USB
        bool "USB"
        select USBSERIAL
    config ESP32_SERIAL_UART0_P03_P02
        bool "Serial (on UART0 P0.3/P0.2)"
        select SERIAL
    config ESP32_SERIAL_UART3_P429_P428
        bool "Serial (on UART3 P4.29/P4.28)" if LOW_LEVEL_OPTIONS
        select SERIAL
endchoice

endif
```
